## config/west.yml
```yaml
manifest:
  remotes:
      # zmk official
    - name: zmkfirmware
      url-base: https://github.com/zmkfirmware
      # bravekarma
    - name: caksoylar
      url-base: https://github.com/caksoylar
    #- name: m165437
    #  url-base: https://github.com/M165437
    - name: gpeye
      url-base: https://github.com/GPeye
  projects:
    - name: zmk
      remote: zmkfirmware
      revision: main
      import: app/west.yml
    #- name: nice-view-gem
    #  remote: m165437
    #  revision: main
    - name: urchin-peripheral-animation
      remote: gpeye
      revision: main
  self:
    path: config
```
